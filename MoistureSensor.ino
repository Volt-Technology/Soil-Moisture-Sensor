#include <Wire.h>
#include <Adafruit_GFX.h>
#include <Adafruit_SSD1306.h>

#define SCREEN_WIDTH 128
#define SCREEN_HEIGHT 64
#define OLED_RESET    -1

Adafruit_SSD1306 display(SCREEN_WIDTH, SCREEN_HEIGHT, &Wire, OLED_RESET);

const int sensor = A3;
const int merah = 13;
const int kuning = 12;
const int hijau = 11;

const int kering = 460;
const int basah = 184;

const int batasKering = 30;
const int batasLembab = 85;

unsigned long akhir = 0;

enum kondisi{KERING, LEMBAB, BASAH};

const unsigned char gelasKering[] PROGMEM = {
	0x00, 0x00, 0x00, 0x00, 0x00, 0x00, 0x00, 0x00, 0x00, 0x00, 0x00, 0x00, 0x00, 0x00, 0x00, 0x00, 
	0x00, 0x00, 0x00, 0x00, 0x00, 0x01, 0x00, 0x00, 0x00, 0x00, 0x01, 0x04, 0x00, 0x00, 0x00, 0x23, 
	0x8c, 0x00, 0x00, 0x00, 0x21, 0x8c, 0x00, 0x00, 0x00, 0x21, 0x86, 0x00, 0x00, 0x00, 0x30, 0x86, 
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	0x00, 0x00, 0x00, 0x00, 0x00, 0x00, 0x00, 0x00, 0x00, 0x00, 0x00, 0x00
};

const unsigned char gelasLembab[] PROGMEM = {
  0x00, 0x00, 0x00, 0x00, 0x00, 0x00, 0x00, 0x00, 0x00, 0x00, 0x00, 0x00, 0x00, 0x00, 0x00, 0x00, 
	0x00, 0x00, 0x00, 0x00, 0x00, 0x00, 0x20, 0x00, 0x00, 0x00, 0x00, 0x70, 0x00, 0x00, 0x00, 0x00, 
	0x70, 0x00, 0x00, 0x00, 0x02, 0x38, 0x00, 0x00, 0x00, 0x06, 0x98, 0x00, 0x00, 0x00, 0x07, 0x78, 
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	0x00, 0x00, 0x00, 0x00, 0x00, 0x00, 0x00, 0x00, 0x00, 0x00, 0x00, 0x00
};

const unsigned char gelasBasah[] PROGMEM = {
  0x00, 0x00, 0x00, 0x00, 0x00, 0x00, 0x00, 0x00, 0x00, 0x00, 0x00, 0x00, 0x00, 0x00, 0x00, 0x00, 
	0x00, 0x03, 0x00, 0x00, 0x00, 0x00, 0x03, 0x80, 0x00, 0x00, 0x00, 0x05, 0x80, 0x00, 0x00, 0x00, 
	0x05, 0xc0, 0x00, 0x00, 0x00, 0x47, 0xc0, 0x00, 0x00, 0x00, 0xa7, 0x80, 0x00, 0x00, 0x00, 0x63, 
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	0x00, 0x00, 0x00, 0x00, 0x00, 0x00, 0x00, 0x00, 0x00, 0x00, 0x00, 0x00
};

float konversi(int adc){
  float persen = (kering - adc) * 100.0 / (kering - basah);
  return constrain(persen, 0.0, 100.0);
}

kondisi air(float persen){
  if(persen < batasKering) return KERING;
  if(persen < batasLembab) return LEMBAB;
  return BASAH;
}

const char* tampilKondisi(kondisi hitung){
  switch(hitung){
    case KERING:
    return "STATUS -> KERING";

    case LEMBAB:
    return "STATUS -> LEMBAB";

    case BASAH:
    return "STATUS -> BASAH";

    default:
    return "TIDAK DIKETAHUI";
  }
}

void gambar(kondisi hitung){
  switch(hitung){
    case KERING:
    display.drawBitmap(90, 6, gelasKering, 34, 44, SSD1306_WHITE);
    break;

    case LEMBAB:
    display.drawBitmap(90, 6, gelasLembab, 34, 44, SSD1306_WHITE);
    break;

    case BASAH:
    display.drawBitmap(90, 6, gelasBasah, 34, 44, SSD1306_WHITE);
    break; 
  }
}

void setup() {
  Serial.begin(9600);
  pinMode(sensor, INPUT);
  pinMode(merah, OUTPUT);
  pinMode(kuning, OUTPUT);
  pinMode(hijau, OUTPUT);

  if(!display.begin(SSD1306_SWITCHCAPVCC, 0x3C)){
    Serial.println("OLED gagal di-inisialisasi!");
    for(;;);
  }

  display.clearDisplay();
  display.setTextSize(1);
  display.setTextColor(SSD1306_WHITE);
}

void loop() {
  if(millis() - akhir >= 500){
    akhir = millis();

    int adc = analogRead(sensor);
    float persen = konversi(adc);

    kondisi hitung = air(persen);

    Serial.print("ADC -> ");
    Serial.print(adc);
    Serial.print(" | ");
    Serial.print("Persen -> ");
    Serial.print(persen, 1);
    Serial.print("% | ");
    Serial.println(tampilKondisi(hitung));

    gantiLampu(hitung);
    oled(persen, hitung);

  }
}

void oled(float persen, kondisi oledd){
  display.clearDisplay();
  gambar(oledd);
  
  display.setTextSize(2);
  display.setCursor(0, 5);
  display.print("KONDISI");

  display.setTextSize(2);
  display.setCursor(5, 27);
  display.print(persen,1);
  display.print("%");

  display.setTextSize(1);
  display.setCursor(0, 53);
  display.print(tampilKondisi(oledd));
  display.display();
}

void gantiLampu(kondisi status){
  digitalWrite(merah, status == KERING);
  digitalWrite(kuning, status == LEMBAB);
  digitalWrite(hijau, status == BASAH);
}
